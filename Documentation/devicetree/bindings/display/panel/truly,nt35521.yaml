## Documentation/devicetree/bindings/display/panel/truly,nt35521.yaml
```yaml
# SPDX-License-Identifier: GPL-2.0
%YAML 1.2
---
$id: http://devicetree.org/schemas/display/panel/truly,nt35521.yaml#
$schema: http://devicetree.org/meta-schemas/core.yaml#

title: Truly NT35521 5.24" 1280x720 IPS LCD panel (MIPI-DSI video mode)

maintainers:
  - Pavel Dubrova <pashadubrova@gmail.com>

description: |
             The Truly NT35521 is a 5.24" 1280x720 IPS LCD panel connected using
             a MIPI-DSI video interface. Its backlight is managed through the DSI link.
allOf:
  - $ref: panel-common.yaml#

properties:

  compatible:
    const: truly,nt35521

  reg:
    maxItems: 1
    description: DSI virtual channel

  enable-gpios: true
  port: true

  reset-gpios:
    maxItems: 1

additionalProperties: false

required:
  - compatible
  - reg

examples:
  - |
    dsi {
      #address-cells = <1>;
      #size-cells = <0>;
      panel@0 {
        compatible = "truly,nt35521";
        reg = <0>;
        reset-gpios = <&tlmm 25 GPIO_ACTIVE_HIGH>;
      };
    };
...
```

## Documentation/devicetree/bindings/interconnect/qcom,msm8939.yaml
```yaml
# SPDX-License-Identifier: (GPL-2.0 OR BSD-2-Clause)
%YAML 1.2
---
$id: http://devicetree.org/schemas/interconnect/qcom,msm8939.yaml#
$schema: http://devicetree.org/meta-schemas/core.yaml#

title: Qualcomm MSM8939 Network-On-Chip interconnect

maintainers:
  - Jun Nie <jun.nie@linaro.org>

description: |
   The Qualcomm MSM8939 interconnect providers support adjusting the
   bandwidth requirements between the various NoC fabrics.

properties:
  compatible:
    enum:
      - qcom,msm8939-bimc
      - qcom,msm8939-pcnoc
      - qcom,msm8939-snoc
      - qcom,msm8939-snoc-mm

  reg:
    maxItems: 1

  '#interconnect-cells':
    const: 1

  clock-names:
    items:
      - const: bus
      - const: bus_a

  clocks:
    items:
      - description: Bus Clock
      - description: Bus A Clock

required:
  - compatible
  - reg
  - '#interconnect-cells'
  - clock-names
  - clocks

additionalProperties: false

examples:
  - |
      #include <dt-bindings/clock/qcom,rpmcc.h>

      bimc: interconnect@400000 {
              compatible = "qcom,msm8939-bimc";
              reg = <0x00400000 0x62000>;
              #interconnect-cells = <1>;
              clock-names = "bus", "bus_a";
              clocks = <&rpmcc RPM_SMD_BIMC_CLK>,
                       <&rpmcc RPM_SMD_BIMC_A_CLK>;
      };

      pcnoc: interconnect@500000 {
              compatible = "qcom,msm8939-pcnoc";
              reg = <0x00500000 0x11000>;
              #interconnect-cells = <1>;
              clock-names = "bus", "bus_a";
              clocks = <&rpmcc RPM_SMD_PCNOC_CLK>,
                       <&rpmcc RPM_SMD_PCNOC_A_CLK>;
      };

      snoc: interconnect@580000 {
              compatible = "qcom,msm8939-snoc";
              reg = <0x00580000 0x14000>;
              #interconnect-cells = <1>;
              clock-names = "bus", "bus_a";
              clocks = <&rpmcc RPM_SMD_SNOC_CLK>,
                       <&rpmcc RPM_SMD_SNOC_A_CLK>;
      };

      snoc_mm: interconnect@580000 {
              compatible = "qcom,msm8939-snoc-mm";
              reg = <0x00580000 0x14000>;
              #interconnect-cells = <1>;
              clock-names = "bus", "bus_a";
	      clocks = <&rpmcc RPM_SMD_MMSSNOC_AHB_CLK>,
		       <&rpmcc RPM_SMD_MMSSNOC_AHB_A_CLK>;
      };
```
